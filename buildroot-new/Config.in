## buildroot-new/Config.in
```kconfig
#

mainmenu "Open2x compliation suite"

config BR2_HAVE_DOT_CONFIG
	bool
	default y

config BR2_VERSION
	string
	default "1.0"

menu "Installation options"

config WGET
	string "Wget command"
	default "wget"

config SVN_CO
	string "Subversion (svn) command to download source tree"
	default "svn co"

config SVN_UP
	string "Subversion (svn) command to update source tree"
	default "svn up"

config ZCAT
	string "zcat command"
	default "zcat"
	help
	  Command to be used to extract a gzip'ed file to stdout.
	  zcat is identical to gunzip -c except that the former may
	  not be available on your system.
	  Default is "gzip -d -c"
	  Other possible values include "gunzip -c" or "zcat".

config BZCAT
	string "bzcat command"
	default "bzcat"
	help
	  Command to be used to extract a bzip2'ed file to stdout.
	  bzcat is identical to bunzip2 -c except that the former may
	  not be available on your system.
	  Default is "bzcat"
	  Other possible values include "bunzip2 -c" or "bzip2 -d -c".

config DL_DIR
	string "Download dir"
	default ./dl
	help
	  Directory to store all the source files that we need to fetch.
	  If the Linux shell environment has defined the BUILDROOT_DL_DIR
	  environment variable, then this overrides this configuration item.

	  The default is ./dl

config O2X_SET_ENV_VARS
	bool "Set environment variables"
	default n
	help
	  Selecting this option will let the installer automatically add lines 
	  to a file of your choice which is parsed by your shell, meaning no 
	  manual configuration of environment variables is needed.

config O2X_SET_ENV_VARS_FILE
	string "File to edit"
	default "~/.bashrc"
	depends O2X_SET_ENV_VARS
	help
	  This is the file that will have environment variables added to so 
	  they needn't be added manually. It should be a file parsed by your 
	  shell when launched (such as /etc/profile or ~/.bashrc).

endmenu

source "toolchain/Config.in"
source "libs/Config.in"
#source "examples/Config.in"
```

## buildroot-new/libs/Config.in
```kconfig
menu "Libraries"

config TARGET_BZIP2
	bool "bzip2"
	default y
	help
	  
config TARGET_FREETYPE
	bool "freetype"
	default y
	help
	  
config TARGET_IMLIB2
	bool "imlib2"
	default y
	help
	  
config TARGET_LIBICONV
	bool "libiconv"
	default y
	help
	  
config TARGET_LIBID3TAG
	bool "libid3tag"
	default y
	help
	  
config TARGET_LIBJPEG
	bool "libjpeg"
	default y
	help
	  
config TARGET_LIBMAD
	bool "libmad"
	default y
	help
	  
config TARGET_LIBMIKMOD
	bool "libmikmod"
	default y
	help
	  
config TARGET_LIBOGG
	bool "libogg"
	default y
	help
	  
config TARGET_LIBPNG
	bool "libpng"
	default y
	help
	  
config TARGET_LIBTIFF
	bool "libtiff"
	default y
	help
	  
config TARGET_LIBUNGIF
	bool "libungif"
	default y
	help
	  
config TARGET_LIBVORBIS
	bool "libvorbis"
	default y
	help
	  
config TARGET_LIBXML2
	bool "libxml2"
	default y
	help
	  
config TARGET_MPEG2DEC
	bool "mpeg2dec"
	default y
	help
	  
config TARGET_NCURSES
	bool "ncurses"
	default y
	help
	  
config TARGET_TREMOR
	bool "tremor"
	default y
	help
	  
config TARGET_READLINE
	bool "readline"
	default y
	help
	  
config TARGET_SDL
	bool "SDL"
	default y
	help
	  
config TARGET_SDL_GFX
	bool "SDL_gfx"
	default y
	help
	  
config TARGET_SDL_IMAGE
	bool "SDL_image"
	default y
	help
	  
config TARGET_SDL_MIXER
	bool "SDL_mixer"
	default y
	help
	  
config TARGET_SDL_SVG
	bool "SDL_svg"
	default y
	help
	  
config TARGET_SDL_TTF
	bool "SDL_ttf"
	default y
	help
	  
config TARGET_SMPEG
	bool "smpeg"
	default y
	help
	  
config TARGET_ZLIB
	bool "zlib"
	default y
	help
	  

endmenu
```

## buildroot-new/toolchain/Config.in
```kconfig
menu "Toolchains"

source "toolchain/application/Config.in"
source "toolchain/kernel/Config.in"

endmenu
```

## buildroot-new/toolchain/application/Config.in
```kconfig
config O2X_TOOLCHAIN_APPLICATION
	bool "Applications"
	default y
	help
	  The recommended toolchain for building applications for the GP2X. Based 
	  around gcc 4.1.1.
```

## buildroot-new/toolchain/kernel/Config.in
```kconfig
config O2X_TOOLCHAIN_KERNEL
	bool "Kernel"
	default y
	help
	  The required toolchain for building kernels for the GP2X. Based around 
	  gcc 3.4.4 (this is the newest version of gcc that can compile a 2.4 
	  series kernel without major modifications).
```

## buildroot/Config.in
```kconfig
#

mainmenu "Buildroot2 Configuration"

config BR2_HAVE_DOT_CONFIG
	bool
	default y

choice
	prompt "Target Architecture"
	default BR2_arm
	help
	  Select the target architecture family to build for.

config BR2_arm
	bool "arm"
endchoice

#
# Keep the variants separate, there's no need to clutter everything else.
# sh is fairly "special" in this regard, as virtually everyone else has
# things kept down to a _sensible_ number of target variants. No such
# luck for sh..
#
choice
	prompt "Target Architecture Variant"
	depends BR2_arm || BR2_armeb
	default BR2_arm920t
	help
	  Specific CPU variant to use

config BR2_generic_arm
	bool "generic_arm"
config BR2_arm920t
	bool "arm920t"
endchoice

config BR2_ARM_TYPE
	string
	default ARM920T		if BR2_arm920t
	default GENERIC_ARM	if BR2_generic_arm

config BR2_ARCH
	string
	default "arm"		if BR2_arm

config BR2_ENDIAN
	string
	default "LITTLE" if BR2_arm || BR2_cris || BR2_i386 || BR2_mipsel || \
	                    BR2_sh3 || BR2_sh4 || BR2_x86_64 || BR2_nios2 || \
			    BR2_sh64
	default "BIG"    if BR2_alpha || BR2_armeb || BR2_avr32 || BR2_m68k || BR2_mips || \
	                    BR2_powerpc || BR2_sh2a_nofpueb || BR2_sh2eb || \
	                    BR2_sh3eb || BR2_sh4eb || BR2_sparc

menu "Build options"

config BR2_WGET
	string "Wget command"
	default "wget --passive-ftp -nd"

config BR2_SVN
	string "Subversion (svn) checkout command"
	default "svn co"

config BR2_ZCAT
	string "zcat command"
	default "gzip -d -c"
	help
	  Command to be used to extract a gzip'ed file to stdout.
	  zcat is identical to gunzip -c except that the former may
	  not be available on your system.
	  Default is "gzip -d -c"
	  Other possible values include "gunzip -c" or "zcat".

config BR2_BZCAT
	string "bzcat command"
	default "bzcat"
	help
	  Command to be used to extract a bzip2'ed file to stdout.
	  bzcat is identical to bunzip2 -c except that the former may
	  not be available on your system.
	  Default is "bzcat"
	  Other possible values include "bunzip2 -c" or "bzip2 -d -c".

config BR2_TAR_OPTIONS
	string "Tar options"
	default ""
	help
	  Options to pass to tar when extracting the sources.
	  E.g. " -v --exclude='*.svn*'" to exclude all .svn internal files
	  and to be verbose.

config BR2_DL_DIR
	string "Download dir"
	default "$(BASE_DIR)/dl"
	help
	  Directory to store all the source files that we need to fetch.

config BR2_SOURCEFORGE_MIRROR
	string "Sourceforge mirror site"
	default "easynews"
	help
	  Sourceforge has a system of mirror sites.  Some sites may be closer
	  to your location, and sometimes mirror sites go down and are no longer
	  available.  This option allows you to select your preferred Sourceforge
	  mirror site.

	  The list of mirrors is available here:
	  http://prdownloads.sourceforge.net/index-sf.html?download
	  
config BR2_STAGING_DIR
	string "Toolchain and header file location?"
	default "$(BUILD_DIR)/staging_dir"
	help
	  This is the location where the toolchain will be installed.  The
	  toolchain will not work if it is moved from this location.
	  Therefore, if you wish to package up a uClibc toolchain, it is
	  important that is is set to the final location where the toolchain
	  will be used.

	  Most people will leave this set to the default value of
	  "$(BUILD_DIR)/staging_dir".

config BR2_TOPDIR_PREFIX
	string "Custom build dir prefix"
	default ""
	help
	  Add a custom string to the beginning of the build directories.

	  build_ARCH -> [PREFIX]_build_ARCH
	  toolchain_build_ARCH -> [PREFIX]_toolchain_build_ARCH

config BR2_TOPDIR_SUFFIX
	string "Custom build dir suffix"
	default ""
	help
	  Add a custom string to the end of the build directories.

	  build_ARCH -> build_ARCH_[SUFFIX]
	  toolchain_build_ARCH -> toolchain_build_ARCH_[SUFFIX] 

config BR2_GNU_BUILD_SUFFIX
	string "GNU build hostname suffix"
	default "pc-linux-gnu"
	help
	  The string used to pass to configure scripts via the
	  --build= option.  Just specify the suffix here, the leading
	  arch will be filled in automatically.

	  Here's some copy and paste build host options for you:
	      linux:   pc-linux-gnu
	      cygwin:  pc-cygwin
	      os x:    apple-darwin7 / apple-darwin8

config BR2_GNU_TARGET_SUFFIX
	string "GNU target suffix"
	default "linux-uclibcgnueabi" if BR2_ARM_EABI
	default "linux-uclibc"
	help
	  The string used to pass to configure scripts via the
	  --target= option.  Just specify the suffix here, the leading
	  arch will be filled in automatically.

	  Most users will want to stick with the default setting, though
	  other users (most notably ARM EABI) like to add on to this in
	  order to stay in line with gcc conventions.

	  Default options are:
	      linux-uclibcgnueabi for ARM EABI
	      linux-uclibc for the rest

config BR2_JLEVEL
	int "Number of jobs to run simultaneously"
	default "1"
	help
	  Number of jobs to run simultaneously

endmenu

source "toolchain/Config.in"

source "package/Config.in"

source "target/Config.in"
```

## buildroot/package/Config.in
```kconfig
menu "Package Selection for the target"


comment "The default minimal system"
source "package/busybox/Config.in"
source "package/fakeroot/Config.in"

comment "Libraries"
source "package/o2xlibs/Config.in"

comment "Applications"
source "package/gmenu2x/Config.in"

comment "System"
source "package/bash/Config.in"
source "package/coreutils/Config.in"
source "package/mkdosfs/Config.in"
source "package/nano/Config.in"
source "package/tftpd/Config.in"
source "package/tinyx/Config.in"
source "package/utelnetd/Config.in"

comment "Development"
source "package/samba/Config.in"

endmenu
```

## buildroot/package/bftpd/Config.in
```kconfig
config BR2_PACKAGE_BFTPD
	bool "bftpd"
	default n
	help
	  A tiny FTP server for embedded devices.
```

## buildroot/package/devfsd/Config.in
```kconfig
config BR2_PACKAGE_DEVFSD
	bool "devfsd"
	default y
	help
	  The dæmon responsible for creating device files. This 
	  is not essential for booting, but compatibility will 
	  be extremely low with existing GP2X applications without.
```

## buildroot/package/glibc/Config.in
```kconfig
config BR2_PACKAGE_GLIBC
	bool "glibc"
	default y
	help

	  glibc is the core (i.e. *very* important) C library 
	  used in most desktop Linux distributions and also 
	  for some embedded devices (such as the GP2X). It is 
	  possible to replace this with uClibc, a lightweight 
	  alternative but this isn't supported or recommended 
	  as it suffers from compatibility problems with most 
	  GP2X software.
	  
	  In summary, DON'T REMOVE THIS!!
```

## buildroot/package/gmenu2x/Config.in
```kconfig
config BR2_PACKAGE_GMENU2X
	bool "GMenu2X"
	default y
	help
	  A complete frontend for the GP2X.
```

## buildroot/package/gp2xsleep/Config.in
```kconfig
config BR2_PACKAGE_GP2XSLEEP
	bool "GP2X Sleep"
	default n
	help
	  A small dæmon which puts the GP2X to sleep upon 
	  pressing a combination of buttons.
```

## buildroot/package/o2xlibs/Config.in
```kconfig
config BR2_PACKAGE_O2XLIBS
	bool "Open2x Libraries"
	default y
	help
	  The basic set of Open2x libraries from a libpack.
```

## buildroot/package/qtopia4/Config.in
```kconfig
config BR2_PACKAGE_QTOPIA4
	bool "qtopia4"
	default n
	select BR2_INSTALL_LIBSTDCPP
	select BR2_PTHREADS_NATIVE
	select BR2_PACKAGE_JPEG
	select BR2_PACKAGE_LIBPNG
	help
	  Qtopia core 4.

	  http://www.trolltech.com/

config BR2_PACKAGE_QTOPIA4_DEBUG
        bool "Compile with debug support"
        default y 
	depends BR2_PACKAGE_QTOPIA4
        help

config BR2_PACKAGE_QTOPIA4_COMMERCIAL_USERNAME
        string "Qtopia Core 4 Commercial License Username"
        default ""
	depends BR2_PACKAGE_QTOPIA4
        help
            Commercial users can download their source directly by providing a username.


config BR2_PACKAGE_QTOPIA4_COMMERCIAL_PASSWORD
        string "Qtopia Core 4 Commercial License Password"
        default ""
	depends BR2_PACKAGE_QTOPIA4
        help
            Commercial users can download their source directly by providing a password.

config BR2_PACKAGE_QTOPIA4_QT3SUPPORT
        bool "Compatibility with Qt3"
        default y 
	depends BR2_PACKAGE_QTOPIA4
        help
	    Turns on support for older Qt3.

config BR2_PACKAGE_QTOPIA4_EMB_PLATFORM
        string "The embedded platform we are making Qtopia4 for"
	default "arm"	if BR2_gp2x
	depends BR2_PACKAGE_QTOPIA4
        help
	    The platform.
```

## buildroot/package/sdl-gfx/Config.in
```kconfig
config BR2_PACKAGE_SDL_GFX
	bool "SDL_gfx"
	default n
	depends BR2_PACKAGE_SDL
	help

	  SDL_gfx adds support for drawing primitives as well 
	  as some rotation and zooming functions to SDL.
```

## buildroot/package/sdl-image/Config.in
```kconfig
config BR2_PACKAGE_SDL_IMAGE
	bool "SDL_image"
	default n
	select BR2_PACKAGE_ZLIB
	select BR2_PACKAGE_LIBPNG
	select BR2_PACKAGE_JPEG
	select BR2_PACKAGE_TIFF
	depends BR2_PACKAGE_SDL
	help

	  SDL_image adds support for various image formats
	  (such as png) to SDL.

choice
	prompt "SDL_image Version"
	depends BR2_PACKAGE_SDL_IMAGE
	default BR2_PACKAGE_SDL_IMAGE_VERSION_1_2_5
	help
	  Select the version of SDL you wish to use.

	config BR2_PACKAGE_SDL_IMAGE_VERSION_1_2_5
		bool "1.2.5"

	config BR2_PACKAGE_SDL_IMAGE_VERSION_LATEST
		bool "Latest"
endchoice

config BR2_PACKAGE_SDL_IMAGE_VERSION
	string
	default "1.2.5"     if BR2_PACKAGE_SDL_IMAGE_VERSION_1_2_5
	default "latest"      if BR2_PACKAGE_SDL_IMAGE_VERSION_LATEST
```

## buildroot/package/sdl/Config.in
```kconfig
config BR2_PACKAGE_SDL
	bool "SDL"
	depends BR2_gp2x
	default n
	help

	  SDL is a cross platform multimedia library often
	  used to write games.

choice
	prompt "SDL Version"
	depends BR2_PACKAGE_SDL
	default BR2_PACKAGE_SDL_VERSION_LATEST
	help
	  Select the version of SDL you wish to use.

#	config BR2_PACKAGE_SDL_VERSION_1_2_9
#		bool "1.2.9"

	config BR2_PACKAGE_SDL_VERSION_LATEST
		bool "Latest"
endchoice

config BR2_PACKAGE_SDL_VERSION
	string
#	default "1.2.9"     if BR2_PACKAGE_SDL_VERSION_1_2_9
	default "latest"      if BR2_PACKAGE_SDL_VERSION_LATEST
```

## buildroot/package/utelnetd/Config.in
```kconfig
config BR2_PACKAGE_UTELNETD
	bool "utelnetd"
	default n
	help
	  A tiny telnet server for embedded devices.
```

## buildroot/target/Config.in
```kconfig
menu "Target Options"

comment "filesystem for target device"

source "target/cramfs/Config.in"
source "target/ext2/Config.in"
source "target/tar/Config.in"
comment "bootloader for target device"

source "target/gp2x/uboot/Config.in"

endmenu
```

## buildroot/target/device/Config.in
```kconfig
menu "Board Support Options"

# This must be last
source "target/generic/Config.in"

endmenu
```

## buildroot/toolchain/Config.in
```kconfig
#

choice
	prompt "Toolchain type"
	default BR2_TOOLCHAIN_EXTERNAL
	help
	  Select which toolchain to use to build the system.

config BR2_TOOLCHAIN_EXTERNAL
	bool
	prompt "External toolchain"
endchoice

source "toolchain/external-toolchain/Config.in"
```
