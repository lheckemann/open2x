## buildroot/toolchain/external-toolchain/Config.in
```kconfig
#

menu "Toolchain Options"
	depends on BR2_TOOLCHAIN_EXTERNAL

config BR2_TOOLCHAIN_EXTERNAL_LIB_C
	string "The core C library from the external toolchain"
	default "libc.so.6"
	help
	  Specify the core C shared library found in the external
	  toolchain. This is required in addition to any other
	  libraries to be copied.

config BR2_TOOLCHAIN_EXTERNAL_LIBS
	string "Libraries to copy from the external toolchain"
	default ""
	help
	  A space separated list of the shared libraries to be copied
	  from the external toolchain into the root filesystem. Only
	  the top-level name is needed, i.e. libc.so, libpthread.so as
	  the actual shared library symlinked to will be copied also.

config O2X_REPO
	string "URL for the Open2x repository you wish to use"
	default "http://x11.gp2x.de/open2x/bins"
	help
	  Normally this should point to the binary repository at 
	  http://x11.gp2x.de/open2x/bins however it can points to any 
	  complete collection of Open2x binaries.

config BR2_TOOLCHAIN_EXTERNAL_STRIP
        bool
        default y
        prompt "Strip shared libraries"
	help
	  Strip shared libraries copied from the external toolchain.

comment "Common Toolchain Options"

config BR2_TOOLCHAIN_EXTERNAL_PATH
	string "External toolchain path"
	default "/opt/open2x/gcc-4.1.1-glibc-2.3.6"
	help
	  Path to where the external toolchain is installed.

config BR2_TOOLCHAIN_EXTERNAL_PREFIX
	string "External toolchain prefix"
	default "arm-open2x-linux"
	help
	  This the the external toolchain prefix. For example:
	    armeb-unknown-linux-gnu, mipsel-unknown-linux-gnu, etc.

choice
	prompt "Thread library implementation"
	default BR2_EXT_PTHREADS_OLD
	help
	  Select the version of libpthreads used in the external toolchain.

	config BR2_EXT_PTHREADS_NONE
		bool
		prompt "none"

	config BR2_EXT_PTHREADS
		bool
		prompt "linuxthreads"

	config BR2_EXT_PTHREADS_OLD
		bool
		prompt "linuxthreads (stable/old)"

	config BR2_EXT_PTHREADS_NATIVE
		bool
		prompt "Native POSIX Threading (NPTL)"
endchoice

config BR2_LARGEFILE
	bool "Enable large file (files > 2 GB) support?"
	depends on !BR2_cris
	default y
	help
	  Enable large file (files > 2 GB) support

config BR2_SOFT_FLOAT
	bool "Use software floating point by default"
	default y
	depends on BR2_arm
	help
	  If your target CPU does not have a Floating Point Unit (FPU) or a
	  kernel FPU emulator, but you still wish to support floating point
	  functions, then everything will need to be compiled with soft
	  floating point support (-msoft-float).

	  For the GP2X, you should answer yes.

config BR2_TARGET_OPTIMIZATION
	string "Target Optimizations"
	default "-Os -pipe"
	help
	  Optimizations to use when building for the target host.

endmenu
```
